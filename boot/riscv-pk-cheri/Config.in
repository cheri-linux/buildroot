## package/libopenssl-cheri/Config.in
```kconfig
config BR2_PACKAGE_LIBOPENSSL_CHERI
	bool "libopenssl-cheri"
	depends on BR2_TOOLCHAIN_CHERI
```

## package/libzlib-cheri/Config.in
```kconfig
config BR2_PACKAGE_LIBZLIB_CHERI
	bool "libzlib-cheri"
	depends on BR2_TOOLCHAIN_CHERI
```

## package/llvm-project/Config.in
```kconfig
config BR2_PACKAGE_LLVM_PROJECT_ARCH_SUPPORTS
	bool
	default y if BR2_i386
	default y if BR2_x86_64
	default y if BR2_aarch64
	default y if BR2_arm || BR2_armeb
	default y if BR2_mips64
	default y if BR2_riscv

config BR2_PACKAGE_LLVM_PROJECT_TARGET_ARCH
	string
	default "AArch64" if BR2_aarch64
	default "ARM" if BR2_arm || BR2_armeb
	default "X86" if BR2_i386 || BR2_x86_64
	default "Mips" if BR2_mips64
	default "RISCV64" if BR2_riscv

config BR2_PACKAGE_LLVM_PROJECT_TARGETS_TO_BUILD
	string
	default "X86;RISCV" if BR2_riscv
	default "X86;Mips" if BR2_mips64

config BR2_PACKAGE_LLVM_PROJECT
	bool "llvm-project"
	depends on BR2_PACKAGE_LLVM_PROJECT_ARCH_SUPPORTS
	depends on BR2_TOOLCHAIN_GCC_AT_LEAST_4_8
	depends on BR2_TOOLCHAIN_HAS_THREADS
	depends on BR2_INSTALL_LIBSTDCPP
	depends on !BR2_TOOLCHAIN_HAS_GCC_BUG_64735 # std::shared_future
	depends on !BR2_STATIC_LIBS
	depends on BR2_USE_WCHAR # std::wstring
	help
	  The LLVM Project is a collection of modular and reusable
	  compiler and toolchain technologies.

	  http://llvm.org

if BR2_PACKAGE_LLVM_PROJECT

config BR2_PACKAGE_LLVM_PROJECT_AMDGPU
	bool "AMDGPU backend"
	help
	  Build AMDGPU target. Select this option if you are going
	  to install mesa3d with llvm and use Gallium Radeon driver.

config BR2_PACKAGE_LLVM_PROJECT_RTTI
	bool "enable rtti"
	help
	  Build LLVM with run-time type information. LLVM can be built
	  without rtti, but turning it off changes the ABI of C++
	  programs.

	  This features is needed to build the Gallium Nouveau driver
	  or the Clover OpenCL state tracker when llvm support is
	  enabled.

	  https://llvm.org/docs/HowToSetUpLLVMStyleRTTI.html

endif

comment "llvm needs a toolchain w/ wchar, threads, C++, gcc >= 4.8, dynamic library"
	depends on BR2_PACKAGE_LLVM_ARCH_SUPPORTS
	depends on !BR2_TOOLCHAIN_HAS_THREADS || !BR2_INSTALL_LIBSTDCPP || \
		!BR2_TOOLCHAIN_GCC_AT_LEAST_4_8 \
		|| BR2_STATIC_LIBS || !BR2_USE_WCHAR

comment "llvm needs a toolchain not affected by GCC bug 64735"
	depends on BR2_PACKAGE_LLVM_ARCH_SUPPORTS
	depends on BR2_TOOLCHAIN_HAS_GCC_BUG_64735
```

## package/musl-cheri-headers/Config.in
```kconfig
config BR2_PACKAGE_MUSL_CHERI_HEADERS
	bool
	default y
	depends on BR2_TOOLCHAIN_CHERI_MUSL
	help
	  https://www.musl-libc.org/
```

## package/openssh-cheri/Config.in
```kconfig
config BR2_PACKAGE_OPENSSH_CHERI
	bool "openssh-cheri"
	depends on BR2_USE_MMU # fork()
	depends on BR2_PACKAGE_MUSL_CHERI
	select BR2_PACKAGE_OPENSSL_CHERI
	select BR2_PACKAGE_ZLIB_CHERI
	help
	  A free version of the SSH protocol suite of network
	  connectivity tools. The standard 'ssh', 'sshd', 'scp', and
	  friends.

	  http://www.openssh.com/
```

## package/util-linux-cheri/Config.in.host
```kconfig
config BR2_PACKAGE_HOST_UTIL_LINUX_CHERI
	bool "host util-linux (CHERI)"
	help
	  Various useful/essential linux libraries and utilities.

	  Things like mkfs, mkswap, swapon, fdisk, mount, dmesg, etc...

	  http://www.kernel.org/pub/linux/utils/util-linux/
```

## toolchain/toolchain-cheri/Config.in
```kconfig
comment "CHERI Toolchain"

config BR2_TOOLCHAIN_CHERI
    bool "Build CHERI Toolchain"

if BR2_TOOLCHAIN_CHERI

choice
    prompt "Cherified C library"
    default BR2_TOOLCHAIN_CHERI_MUSL

config BR2_TOOLCHAIN_CHERI_MUSL
    bool "musl"
    depends on BR2_RISCV_64
    depends on BR2_USE_MMU
    help
      This option selects musl as the cherified C library for the
      cross-compilation CHERI toolchain.

      https://www.musl-libc.org/

config BR2_TOOLCHAIN_CHERI_GLIBC
    bool "glibc"
    depends on BR2_RISCV_64
    depends on BR2_RISCV_ISA_RVA
    depends on BR2_USE_MMU
    depends on !BR2_STATIC_LIBS
    depends on BR2_TOOLCHAIN_HEADERS_AT_LEAST_5_0
    help
      This option selects the cherified glibc as the C library for the
      cross-compilation CHERI toolchain.

      http://www.gnu.org/software/libc/

endchoice

config BR2_TOOLCHAIN_CHERI_LIBC
    string
    default "musl-cheri" if BR2_TOOLCHAIN_CHERI_MUSL
    default "glibc-cheri" if BR2_TOOLCHAIN_CHERI_GLIBC

endif # BR2_TOOLCHAIN_CHERI

source "package/musl-cheri/Config.in"
source "package/musl-cheri-headers/Config.in"
source "package/glibc-cheri/Config.in"
source "package/glibc-cheri-headers/Config.in"
```
